## app/jinsechuanshuo_ballbes/Kconfig
```kconfig
menuconfig EXAMPLES_JINSECHUANSHUO_BALL_BES
	tristate "Golden Legend Tennis App (BES2800)"
	default n
	depends on GRAPHICS_LVGL

if EXAMPLES_JINSECHUANSHUO_BALL_BES

config EXAMPLES_JINSECHUANSHUO_BALL_BES_PRIORITY
	int "Elderly app task priority"
	default 100

config EXAMPLES_JINSECHUANSHUO_BALL_BES_STACKSIZE
	int "Elderly app stack size"
	default 65536

config EXAMPLES_JINSECHUANSHUO_BALL_BES_INPUT_DEVPATH
	string "Touchscreen device path"
	default "/dev/input0"
	depends on INPUT_TOUCHSCREEN

config EXAMPLES_JINSECHUANSHUO_BALL_BES_SCREEN_WIDTH
	int "Screen width in pixels"
	default 454

config EXAMPLES_JINSECHUANSHUO_BALL_BES_SCREEN_HEIGHT
	int "Screen height in pixels"
	default 454

config EXAMPLES_JINSECHUANSHUO_BALL_BES_SERVER_URL
	string "Backend server URL"
	default "http://101.35.231.154/api/v1"

config EXAMPLES_JINSECHUANSHUO_BALL_BES_DEVICE_SN
	string "Device serial number"
	default "EH-WATCH-BES2800"

config EXAMPLES_JINSECHUANSHUO_BALL_BES_DEFAULT_INTERVAL
	int "Default data collection interval (seconds)"
	default 10

endif # EXAMPLES_JINSECHUANSHUO_BALL_BES
```

## board/contest_board/Kconfig
```kconfig
#
# Contest 2026 team 319 - BES2800BP board
#

if ARCH_BOARD_CONTEST2026_319_BOARD

config ARCH_BOARD_CONTEST2026_319_BOARD_TAG
	string "Board tag"
	default "contest2026_319_board"

# SPI Flash FAT filesystem

config SPI_FLASH_FATFS
	bool "SPI Flash with FAT file system"
	default n
	depends on BES_HAVE_SPI
	---help---
		Adds support for SPI Flash with FAT file system.
		Requires CONFIG_SPI, CONFIG_MTD, CONFIG_FS_FATFS, and CONFIG_FTL.

if SPI_FLASH_FATFS

config BES_SPI_FLASH_CSNUM
	int "SPI Flash chip select number"
	default 0
	---help---
		SPI chip select number for the SPI Flash device.

config BES_SPI_FLASH_MOUNTPOINT
	string "SPI Flash mount point"
	default "/mnt/spiflash"
	---help---
		Mount point for the SPI Flash FAT file system.

endif # SPI_FLASH_FATFS

# BMI160 IMU sensor

config SPI_IMU
	bool "SPI IMU sensor support"
	default n
	depends on BES_HAVE_SPI
	select SENSORS_BMI160
	# Note: SENSORS_BMI160_SPI is a choice symbol and cannot be selected
	# The user must enable BMI160 SPI interface manually via menuconfig
	---help---
		Adds support for SPI IMU (BMI160) sensor.
		Uses SPI0 with CS1 for IMU connection.

if SPI_IMU

config BES_SPI_IMU_CSNUM
	int "SPI IMU chip select number"
	default 1
	---help---
		SPI chip select number for the IMU device.
		Default is 1 (CS1), as CS0 is used by SPI Flash.

config BES_SPI_IMU_DEVNAME
	string "IMU device name"
	default "/dev/accel0"
	---help---
		Device name for the IMU sensor.

endif # SPI_IMU

endif # ARCH_BOARD_CONTEST2026_319_BOARD
```
